## CMakeLists.txt
```
cmake_minimum_required(VERSION 3.20)

set(EXTRA_ZEPHYR_MODULES "${CMAKE_CURRENT_SOURCE_DIR}/../../modules/rp2040_bootloader")

# set(DTC_OVERLAY_FILE "${CMAKE_CURRENT_SOURCE_DIR}/app.overlay")
# set(DTS_ROOT "${CMAKE_CURRENT_SOURCE_DIR}")

find_package(Zephyr REQUIRED HINTS $ENV{ZEPHYR_BASE})
project(my_cpp23_project)

# Use absolute pathing based on where this CMakeLists.txt lives
target_sources(app PRIVATE ${CMAKE_CURRENT_LIST_DIR}/src/main.cpp)
target_include_directories(app PRIVATE ${CMAKE_CURRENT_LIST_DIR}/../../modules/rp2040_bootloader/include)

target_compile_features(app PUBLIC cxx_std_23)
```

## prj.conf
```kconfig
# Enable C++ Support
CONFIG_CPP=y
CONFIG_STD_CPP23=y
CONFIG_EXTERNAL_LIBCPP=y

# Use Newlib
CONFIG_NEWLIB_LIBC=y

# Generic Zephyr settings
CONFIG_GPIO=y
CONFIG_SPI=y

# Monitoring and stuff
CONFIG_USB_DEVICE_STACK_NEXT=y
CONFIG_USBD_CDC_ACM_CLASS=y
CONFIG_CDC_ACM_SERIAL_INITIALIZE_AT_BOOT=y
CONFIG_SERIAL=y
CONFIG_CONSOLE=y
CONFIG_UART_CONSOLE=y
CONFIG_UART_LINE_CTRL=y

# Playground
CONFIG_SHELL=y
CONFIG_DEVICE_SHELL=y
CONFIG_UART_INTERRUPT_DRIVEN=y

# RP2040 Bootloader module
CONFIG_RP2040_BOOTLOADER=y
```

## boards/button.overlay
```dts
/ {
    aliases {
        my-button = &button_1;
    };

    buttons {
        compatible = "gpio-keys";
        debounce-interval-ms = <50>;
        polling-mode;

        button_1: d5 {
            // On gpio controller 0 we configure pin 5 to be our button pin
            gpios = <&gpio0 5 (GPIO_ACTIVE_LOW | GPIO_PULL_UP)>;
        };
    };
};
```

## src/main.cpp
```c
#include <zephyr/drivers/gpio.h>
#include <zephyr/kernel.h>
#include <zephyr/kernel.h>

#include "bootloader_cmd.h"

// Constants
static const int32_t sleep_time_ms = 100;
static const struct gpio_dt_spec btn = GPIO_DT_SPEC_GET(DT_ALIAS(my_button), gpios);

int main(void)
{
    int ret;
    int state;

    // Make sure that the button was initialized
    if (!gpio_is_ready_dt(&btn)) {
        printk("ERROR: button not ready\r\n");
        return 0;
    }

    // Set the button as input (apply extra flags if needed)
    ret = gpio_pin_configure_dt(&btn, GPIO_INPUT);
    if (ret < 0) {
        return 0;
    }

    // Print out the flags
    printk("Button spec flags: 0x%x\r\n", btn.dt_flags);

    while (1) {
        state = gpio_pin_get_dt(&btn);

        if (state < 0) {
            printk("Error %d: failed to read button pin\r\n", state);
        } else {
            printk("Button state: %d\r\n", state);
        }

        k_msleep(sleep_time_ms);
    }

    (void)cmd_bootloader; // Prevent LSP error
    return 0;
}
```
