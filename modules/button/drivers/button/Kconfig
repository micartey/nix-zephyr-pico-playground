## modules/button/drivers/button/Kconfig
```kconfig
config CUSTOM_BUTTON
	bool "Custom Button GPIO driver"
	help
	  Enable the custom button GPIO driver for reading button states.
```

## modules/button/dts/bindings/input/custom,button.yaml
```yaml
description: Custom button

# Needs to macht: DT_DRV_COMPAT custom_button
compatible: "custom,button"

# Define required ndoes properties
properties:
  gpios:
    type: phandle-array
    required: true
```

## modules/hid_keyboard/Kconfig
```kconfig
config HID_KEYBOARD
    bool "hid keyboard interface"
    default y
    depends on USBD_HID_SUPPORT
    help
      Registers the device as a keyboard
```

## modules/rp2040_bootloader/Kconfig
```kconfig
config RP2040_BOOTLOADER
    bool "RP2040 USB Bootloader shell command"
    default y
    depends on SHELL && DEVICE_SHELL && UART_INTERRUPT_DRIVEN
    help
      Enables the bootloader shell command to reboot the RP2040 into BOOTSEL mode.
```
